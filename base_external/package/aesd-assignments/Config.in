## base_external/package/aesd-assignments/Config.in
```kconfig
config BR2_PACKAGE_AESD_ASSIGNMENTS
	bool "aesd-assignments"
	help
	  Includes aesdsocket in the kernel image.
	  Used to understand buildroot external trees and package builds.
```

## base_external/package/aesd-chardev/Config.in
```kconfig
config BR2_PACKAGE_AESD_CHARDEV
	bool "aesd-chardev"
	help
	  Adds the aesd_chardev device.
	  Used to understand buildroot external trees and package builds.
```

## base_external/package/midi-reader/Config.in
```kconfig
config BR2_PACKAGE_MIDI_READER
	bool "midi-reader"
	help
	  Used to read USB Midi and translate to voltages
	  For final project.
```
